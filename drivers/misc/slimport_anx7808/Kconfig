## drivers/misc/slimport_anx7808/Kconfig
```kconfig
config SLIMPORT_ANX7808
	tristate "Analogix Slimport transmitter ANX7808 support"
	help
	  Slimport Transmitter is a HD video transmitter chip
	  over micro-USB connector for smartphone device.

config SLIMPORT_REGISTER_SET_TEST
	tristate "Register set test for Analogix ANX7808 support"
	depends on SLIMPORT_ANX7808
	help
	  This is the debugging feature when initiation the ANX7808 TX driver 
	  It will print out the valueis and change them through debug fs
```
